## boards/shields/urchin/Kconfig.shield
```kconfig
# No whitespace after the comma or in your part name!
config SHIELD_URCHIN_LEFT
    def_bool $(shields_list_contains,urchin_left)

# No whitespace after the comma or in your part name!
config SHIELD_URCHIN_RIGHT
    def_bool $(shields_list_contains,urchin_right)
```
